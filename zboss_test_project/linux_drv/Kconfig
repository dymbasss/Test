## zboss_test_project/linux_drv/Kconfig
```kconfig
if ARCH_MX3

config ARCH_MX31
	select ARCH_HAS_RNGA
	bool
	
	
config ARCH_MX31JADE
	select SLAB
	select KMOD
	select ISP1504_MXC
	select ISA
	select IEEE80211
	select MXC_NAND_Support
	select BLK_DEV_RAM_BLOCKSIZE
	select DM9003
	select WLAN_80211
	select RT73
	select RT73_WPA
	select RALINK_WPA_SUPPLICANT_SUPPORT
	select PPP
	select PPP_ASYNC
	select PPP_SYNC_TTY
	select PPP_DEFLATE
	select SLHC
	select INPUT_MOUSEDEV
	select INPUT_MOUSEDEV_PSAUX
	select SERIO
	select SERIO_SERPORT
	select SERIO_LIBPS2
	select VC_BLANKINTERVAL
#	select SERIAL_MXC
#	select SERIAL_MXC_CONSOLE
	select DEVPORT
	select I2C_MXC
	select SPI_MXC
	select SPI_MXC_SELECT2
	select FB_CFB_FILLRECT
	select FB_CFB_COPYAREA
	select FB_CFB_IMAGEBLIT
	select FB_DEFERRED_IO
	select FB_MXC
	select FB_MXC_BPP_16
	select FB_MXC_ROTATION_0
	select FB_MXC_SYNC_PANEL
#	select USB_HID
#	select USB_EHCI_HCD
#	select USB_EHCI_ARC
#	select USB_EHCI_ROOT_HUB_TT
#	select USB_GADGET_ARC_OTG
	select USB_EHCI_FSL_1504
	select USB_GADGET_FSL_1504
	select MXC_IPU
	select MXC_IPU_PF
#	select MXC_SSI
	select MXC_DAM
	select MXC_SECURITY_SCC
	select MXC_SECURITY_RNG
	select MXC_SECURITY_RTIC
	select MXC_SECURITY_CORE
	select EXT3_FS
	select EXT3_FS_XATTR
	select JBD
	select FS_MBCACHE
	select RAMFS
	select JFFS2_COMPRESSION_OPTIONS
	select JFFS2_CMODE_NONE
	select FRAME_POINTER
	select PLIST
	select DEBUG_KERNEL
	select DEBUG_LL
	select VT_CONSOLE
	select VC_BLANKINTERVAL
	select SERIAL_MXC
	select SERIAL_MXC_CONSOLE
	select MTD_NAND_Support
	select MTD_NAND_MXC_HY27SF081G2A
	bool

config MX3_OPTIONS
	bool
	default y
	select CPU_V6
	select ARM_ERRATA_364296
	select ARM_ERRATA_411920
	select CACHE_L2X0
	select OUTER_CACHE
	select USB_ARCH_HAS_EHCI
	select ARCH_HAS_EVTMON
	select ARCH_HAS_RNGA

comment "MX3 platforms:"

config MACH_MX31ADS
	bool "Support MX31ADS platforms" if !MACH_MX31JADE
	select ARCH_MX31
	help
	  Include support for MX31ADS platform. This includes specific
	  configurations for the board and its peripherals.
	  
	  
	  
config MACH_MX31JADE
	bool "Support MX31JADE platforms"
	select ARCH_MX31
	select ARCH_MX31JADE
	default y
	help
	  Include support for MX31JADE_COMMON platform. This includes specific
	  configurations for the board and its peripherals.


choice
	prompt "MX31JADE_BOARD:"
	depends on MACH_MX31JADE
	default MACH_MX31JADE_V5
	  
config MACH_MX31JADE_V5
	bool "Support MX31JADE_V5 platforms"
#	depends on MACH_MX31JADE
	select ARCH_MX31
	default y
	help
	  Include support for MX31JADE_V5 platform. This includes specific
	  configurations for the board and its peripherals.

config MACH_MX31JADE_REID
	bool "Support MX31JADE_REID platforms"
#	depends on MACH_MX31JADE
	select ARCH_MX31
	help
	  Include support for MX31JADE_REID platform. This includes specific
	  configurations for the board and its peripherals.

config MACH_MX31JADE_UL
	bool "Support MX31JADE_UL platforms"
#	depends on MACH_MX31JADE
	select ARCH_MX31
	help
	  Include support for MX31JADE_UL platform. This includes specific
	  configurations for the board and its peripherals.
	  
config MACH_MX31JADE_HYDRA
	bool "Support MX31JADE_HYDRA platforms"
#	depends on MACH_MX31JADE
	select ARCH_MX31
	help
	  Include support for MX31JADE_HYDRA platform. This includes specific
	  configurations for the board and its peripherals.
	  
config MACH_MX31JADE_RTRS
	bool "Support MX31JADE_RTRS platforms"
#	depends on MACH_MX31JADE
	select ARCH_MX31
	help
	  Include support for MX31JADE_RTRS platform. This includes specific
	  configurations for the board and its peripherals.
	  
endchoice

config ZIGBEE_INTR
	bool "UZ2400 interrupt driver"
	depends on MACH_MX31JADE_RTRS
	help
          Driver for passing UZ2400 interrupt to userspave via select()

config MACH_MX31ADS_WM1133_EV1
	bool "Support Wolfson Microelectronics 1133-EV1 module" if !MACH_MX31JADE
	depends on MACH_MX31ADS
	depends on MFD_WM8350_I2C
	depends on REGULATOR_WM8350
	select MFD_WM8350_CONFIG_MODE_0
	select MFD_WM8352_CONFIG_MODE_0
	help
	  Include support for the Wolfson Microelectronics 1133-EV1 PMU
	  and audio module for the MX31ADS platform.

config MACH_PCM037
	bool "Support Phytec pcm037 (i.MX31) platforms" if !MACH_MX31JADE
	select ARCH_MX31
	help
	  Include support for Phytec pcm037 platform. This includes
	  specific configurations for the board and its peripherals.

config MACH_PCM037_EET
	bool "Support pcm037 EET board extensions" if !MACH_MX31JADE
	depends on MACH_PCM037
	help
	  Add support for PCM037 EET baseboard extensions. If you are using the
	  OLED display with EET, use "video=mx3fb:CMEL-OLED" kernel
	  command-line parameter.

config MACH_MX31LITE
	bool "Support MX31 LITEKIT (LogicPD)" if !MACH_MX31JADE
	select ARCH_MX31
	help
	  Include support for MX31 LITEKIT platform. This includes specific
	  configurations for the board and its peripherals.

config MACH_MX31_3DS
	bool "Support MX31PDK (3DS)" if !MACH_MX31JADE
	select ARCH_MX31
	help
	  Include support for MX31PDK (3DS) platform. This includes specific
	  configurations for the board and its peripherals.

config MACH_MX31MOBOARD
	bool "Support mx31moboard platforms (EPFL Mobots group)" if !MACH_MX31JADE
	select ARCH_MX31
	help
	  Include support for mx31moboard platform. This includes specific
	  configurations for the board and its peripherals.

config MACH_MX31LILLY
	bool "Support MX31 LILLY-1131 platforms (INCO startec)" if !MACH_MX31JADE
	select ARCH_MX31
	help
	  Include support for mx31 based LILLY1131 modules. This includes
	  specific configurations for the board and its peripherals.

config MACH_QONG
	bool "Support Dave/DENX QongEVB-LITE platform" if !MACH_MX31JADE
	select ARCH_MX31
	help
	  Include support for Dave/DENX QongEVB-LITE platform. This includes
	  specific configurations for the board and its peripherals.

config MACH_PCM043
	bool "Support Phytec pcm043 (i.MX35) platforms" if !MACH_MX31JADE
#	select ARCH_MX35
	help
	  Include support for Phytec pcm043 platform. This includes
	  specific configurations for the board and its peripherals.

config MACH_ARMADILLO5X0
	bool "Support Atmark Armadillo-500 Development Base Board" if !MACH_MX31JADE
	select ARCH_MX31
	help
	  Include support for Atmark Armadillo-500 platform. This includes
	  specific configurations for the board and its peripherals.
	  Include support for Phytec pcm043 platform. This includes
	  specific configurations for the board and its peripherals.

config MXC_SDMA_API
        bool "Use SDMA API"
        default y
        help
           This selects the Freescale MXC SDMA API.
           If unsure, say N.

menu "SDMA options"
        depends on MXC_SDMA_API

config SDMA_IRAM
        bool "Use Internal RAM for SDMA transfer"
        default n
	help
           Support Internal RAM as SDMA buffer or control structures

config SDMA_IRAM_SIZE
        hex "Reserved bytes of IRAM for SDMA (0x800-0x2000)"
        range 0x800 0x2000
        depends on SDMA_IRAM
        default "0x1000"
        help
           Set the size of IRAM for SDMA. It must be multiple of 512bytes.
endmenu

config ARCH_MXC_HAS_NFC_V1
        bool "MXC NFC Hardware Version 1"
	depends on !((MACH_MX31ADS || MACH_MX31JADE) && XIP_KERNEL)
        default y
        help
           This selects the Freescale MXC Nand Flash Controller Hardware Version 1
           If unsure, say N.

config ARCH_MXC_HAS_NFC_V2
        bool "MXC NFC Hardware Version 2"
	depends on !((MACH_MX31ADS || MACH_MX31JADE) && XIP_KERNEL)
        default y
        help
           This selects the Freescale MXC Nand Flash Controller Hardware Version 2
           If unsure, say N.

menu "Device options"

config I2C_MXC_SELECT1
	bool "Enable I2C1 module"
	default y
	depends on I2C_MXC
	help
	  Enable MX31 I2C1 module.

config I2C_MXC_SELECT2
	bool "Enable I2C2 module"
	default n
	depends on I2C_MXC
	help
	  Enable MX31 I2C2 module.

config I2C_MXC_SELECT3
	bool "Enable I2C3 module"
	default n
	depends on I2C_MXC
	help
	  Enable MX31 I2C3 module.

endmenu
endif
```
